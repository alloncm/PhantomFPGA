## platform/buildroot/configs/phantomfpga_aarch64_defconfig
```kconfig
# PhantomFPGA aarch64 Buildroot Configuration
# Minimal Linux guest for FPGA driver development training
#
# Build with:
#   make O=output/aarch64 phantomfpga_aarch64_defconfig
#   make O=output/aarch64
#
# Cross-compile only - no on-target compilation tools.
# Driver modules are built on host and deployed via 9p virtfs.
#
# TOOLCHAIN: The Makefile automatically selects the best option:
#   - x86_64 host: Bootlin pre-built (fast)
#   - Other hosts: Build from source (~15 min, one-time)

#------------------------------------------------------------------------------
# Target Architecture
#------------------------------------------------------------------------------
BR2_aarch64=y
BR2_cortex_a72=y
BR2_ARM64_PAGE_SIZE_4K=y

#------------------------------------------------------------------------------
# Toolchain Configuration (base: build from source with glibc)
# The Makefile may override this with Bootlin or system toolchain
#------------------------------------------------------------------------------
BR2_TOOLCHAIN_BUILDROOT_GLIBC=y
BR2_INSTALL_LIBSTDCPP=y
BR2_KERNEL_HEADERS_6_6=y

#------------------------------------------------------------------------------
# Busybox Configuration
#------------------------------------------------------------------------------
BR2_PACKAGE_BUSYBOX_SHOW_OTHERS=y

#------------------------------------------------------------------------------
# Linux Kernel Configuration
#------------------------------------------------------------------------------
BR2_LINUX_KERNEL=y
BR2_LINUX_KERNEL_CUSTOM_VERSION=y
BR2_LINUX_KERNEL_CUSTOM_VERSION_VALUE="6.6.70"
BR2_LINUX_KERNEL_USE_ARCH_DEFAULT_CONFIG=y
BR2_LINUX_KERNEL_IMAGE="Image"
BR2_LINUX_KERNEL_INSTALL_TARGET=y
BR2_LINUX_KERNEL_NEEDS_HOST_OPENSSL=y

#------------------------------------------------------------------------------
# Essential Utilities for PCIe/Driver Work
#------------------------------------------------------------------------------
BR2_PACKAGE_PCIUTILS=y
BR2_PACKAGE_USBUTILS=y
BR2_PACKAGE_UTIL_LINUX=y
BR2_PACKAGE_UTIL_LINUX_BINARIES=y
BR2_PACKAGE_KMOD=y
BR2_PACKAGE_KMOD_TOOLS=y

#------------------------------------------------------------------------------
# Development & Debugging Tools
#------------------------------------------------------------------------------
BR2_PACKAGE_STRACE=y
BR2_PACKAGE_FILE=y
BR2_PACKAGE_LESS=y
# Note: gdbserver provided via overlay (static binary)

# Editor and terminal multiplexer
BR2_PACKAGE_VIM=y
BR2_PACKAGE_TMUX=y

# File managers and utilities
BR2_PACKAGE_MC=y
BR2_PACKAGE_TREE=y

#------------------------------------------------------------------------------
# Network Utilities
#------------------------------------------------------------------------------
# Dropbear - lightweight SSH server
BR2_PACKAGE_DROPBEAR=y
BR2_PACKAGE_IPROUTE2=y
BR2_PACKAGE_IPUTILS=y

#------------------------------------------------------------------------------
# Filesystem Configuration
#------------------------------------------------------------------------------
BR2_TARGET_ROOTFS_EXT2=y
BR2_TARGET_ROOTFS_EXT2_4=y
BR2_TARGET_ROOTFS_EXT2_SIZE="256M"
BR2_TARGET_ROOTFS_EXT2_LABEL="PHANTOMFPGA"

# cpio for initramfs if needed
BR2_TARGET_ROOTFS_CPIO=y
BR2_TARGET_ROOTFS_CPIO_GZIP=y

#------------------------------------------------------------------------------
# Init System
#------------------------------------------------------------------------------
BR2_INIT_BUSYBOX=y
BR2_ROOTFS_DEVICE_CREATION_DYNAMIC_DEVTMPFS=y

#------------------------------------------------------------------------------
# Console Configuration (aarch64 typically uses ttyAMA0)
#------------------------------------------------------------------------------
BR2_TARGET_GENERIC_GETTY_PORT="ttyAMA0"
BR2_TARGET_GENERIC_GETTY_BAUDRATE_115200=y

#------------------------------------------------------------------------------
# System Settings
#------------------------------------------------------------------------------
BR2_TARGET_LOCALTIME="UTC"
BR2_GENERATE_LOCALE=""
BR2_TARGET_GENERIC_ROOT_PASSWD="root"
BR2_TARGET_GENERIC_HOSTNAME="phantomfpga"
BR2_TARGET_GENERIC_ISSUE="Welcome to PhantomFPGA Training Environment"
```

## platform/buildroot/configs/phantomfpga_x86_64_defconfig
```kconfig
# PhantomFPGA x86_64 Buildroot Configuration
# Minimal Linux guest for FPGA driver development training
#
# Build with:
#   make O=output/x86_64 phantomfpga_x86_64_defconfig
#   make O=output/x86_64
#
# Cross-compile only - no on-target compilation tools.
# Driver modules are built on host and deployed via 9p virtfs.
#
# TOOLCHAIN: The Makefile automatically selects the best option:
#   - x86_64 host: Bootlin pre-built (fast)
#   - Other hosts: Build from source (~15 min, one-time)

#------------------------------------------------------------------------------
# Target Architecture
#------------------------------------------------------------------------------
BR2_x86_64=y
# Generic x86_64 baseline. Note: glibc 2.42+ uses SSE4.1 optimizations,
# so when emulating on aarch64 hosts (no KVM), use -cpu Nehalem or higher.

#------------------------------------------------------------------------------
# Toolchain Configuration (base: build from source with glibc)
# The Makefile may override this with Bootlin or system toolchain
#------------------------------------------------------------------------------
BR2_TOOLCHAIN_BUILDROOT_GLIBC=y
BR2_KERNEL_HEADERS_6_6=y

#------------------------------------------------------------------------------
# Busybox Configuration
#------------------------------------------------------------------------------
BR2_PACKAGE_BUSYBOX_SHOW_OTHERS=y

#------------------------------------------------------------------------------
# Linux Kernel Configuration
#------------------------------------------------------------------------------
BR2_LINUX_KERNEL=y
BR2_LINUX_KERNEL_CUSTOM_VERSION=y
BR2_LINUX_KERNEL_CUSTOM_VERSION_VALUE="6.6.70"
BR2_LINUX_KERNEL_USE_DEFCONFIG=y
BR2_LINUX_KERNEL_DEFCONFIG="x86_64"
BR2_LINUX_KERNEL_INSTALL_TARGET=y
BR2_LINUX_KERNEL_NEEDS_HOST_OPENSSL=y

#------------------------------------------------------------------------------
# Essential Utilities for PCIe/Driver Work
#------------------------------------------------------------------------------
BR2_PACKAGE_PCIUTILS=y
BR2_PACKAGE_USBUTILS=y
BR2_PACKAGE_UTIL_LINUX=y
BR2_PACKAGE_UTIL_LINUX_BINARIES=y
BR2_PACKAGE_KMOD=y
BR2_PACKAGE_KMOD_TOOLS=y

#------------------------------------------------------------------------------
# Development & Debugging Tools
#------------------------------------------------------------------------------
BR2_PACKAGE_STRACE=y
BR2_PACKAGE_FILE=y
BR2_PACKAGE_LESS=y
# Note: gdbserver provided via overlay (static binary, no C++ needed)

# Editor and terminal multiplexer
BR2_PACKAGE_VIM=y
BR2_PACKAGE_TMUX=y

# File managers and utilities
BR2_PACKAGE_MC=y
BR2_PACKAGE_TREE=y

#------------------------------------------------------------------------------
# Network Utilities
#------------------------------------------------------------------------------
# Dropbear - lightweight SSH server
BR2_PACKAGE_DROPBEAR=y
BR2_PACKAGE_IPROUTE2=y
BR2_PACKAGE_IPUTILS=y

#------------------------------------------------------------------------------
# Filesystem Configuration
#------------------------------------------------------------------------------
BR2_TARGET_ROOTFS_EXT2=y
BR2_TARGET_ROOTFS_EXT2_4=y
BR2_TARGET_ROOTFS_EXT2_SIZE="256M"
BR2_TARGET_ROOTFS_EXT2_LABEL="PHANTOMFPGA"

# cpio for initramfs if needed
BR2_TARGET_ROOTFS_CPIO=y
BR2_TARGET_ROOTFS_CPIO_GZIP=y

#------------------------------------------------------------------------------
# Init System
#------------------------------------------------------------------------------
BR2_INIT_BUSYBOX=y
BR2_ROOTFS_DEVICE_CREATION_DYNAMIC_DEVTMPFS=y

#------------------------------------------------------------------------------
# Console Configuration
#------------------------------------------------------------------------------
BR2_TARGET_GENERIC_GETTY_PORT="ttyS0"
BR2_TARGET_GENERIC_GETTY_BAUDRATE_115200=y

#------------------------------------------------------------------------------
# System Settings
#------------------------------------------------------------------------------
BR2_TARGET_LOCALTIME="UTC"
BR2_GENERATE_LOCALE=""
BR2_TARGET_GENERIC_ROOT_PASSWD="root"
BR2_TARGET_GENERIC_HOSTNAME="phantomfpga"
BR2_TARGET_GENERIC_ISSUE="Welcome to PhantomFPGA Training Environment"
```
